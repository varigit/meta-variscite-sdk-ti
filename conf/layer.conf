## conf/layer.conf
```bitbake
# We have a conf and classes directory, add to BBPATH
BBPATH .= ":${LAYERDIR}"

# We have a packages directory, add to BBFILES
BBFILES += "${LAYERDIR}/recipes-*/*/*.bb \
            ${LAYERDIR}/recipes-*/*/*.bbappend"

BBFILE_COLLECTIONS += "variscite-ti-sdk"
BBFILE_PATTERN_variscite-ti-sdk:= "^${LAYERDIR}/"
BBFILE_PRIORITY_variscite-ti-sdk= "16"

LAYERSERIES_COMPAT_variscite-ti-sdk= "dunfell"

BBFILES_DYNAMIC += " \
    meta-arago-distro:${LAYERDIR}/dynamic-layers/meta-arago-distro/*/*/*.bb \
    meta-arago-distro:${LAYERDIR}/dynamic-layers/meta-arago-distro/*/*/*.bbappend \
    \
    swupdate:${LAYERDIR}/dynamic-layers/swupdate/*.bb \
    swupdate:${LAYERDIR}/dynamic-layers/swupdate/*.bbappend \
"
```
